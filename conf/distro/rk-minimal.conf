## conf/distro/rk-minimal.conf
```bitbake
# poky-tiny could reduce size, but we need more functions!
require conf/distro/poky-tiny.conf

PREFERRED_PROVIDER_virtual/kernel = "linux-dummy"

DEFAULTTUNE_rk3036="cortexa7hf-neon-vfpv4"
DEFAULTTUNE_rk3288="cortexa17hf-neon-vfpv4"
DEFAULTTUNE_rk3328="aarch64"
DEFAULTTUNE_rk3399="aarch64"

IMAGE_FSTYPES = "cpio.gz"
IMAGE_CLASSES = ""
```
